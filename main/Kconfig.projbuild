## main/Kconfig.projbuild
```kconfig
menu "WiFi Configuration"

    config WIFI_SSID
        string "WiFi SSID"
        default "myssid"
        help
            SSID (network name) to connect to.

    config WIFI_PASSWORD
        string "WiFi Password"
        default "mypassword"
        help
            WiFi password (WPA2).

endmenu

menu "USB HID Descriptor"

    config USB_DESC_MANUFACTURER
        string "Manufacturer"
        default "ESP32"
        help
            USB device manufacturer string.

    config USB_DESC_PRODUCT
        string "Product"
        default "Wireless KVM"
        help
            USB device product string.

    config USB_DESC_SERIAL
        string "Serial Number"
        default "000000000001"
        help
            USB device serial number string.

    config USB_DESC_VID
        hex "Vendor ID"
        default 0x303A
        help
            USB Vendor ID (0x303A = Espressif).

    config USB_DESC_PID
        hex "Product ID"
        default 0x4001
        help
            USB Product ID.

endmenu
```

## sdkconfig.defaults
```kconfig
# Target: ESP32-S3
CONFIG_IDF_TARGET="esp32s3"

# USB OTG (ESP32-S3 native USB)
CONFIG_TINYUSB_HID_COUNT=1

# FreeRTOS
CONFIG_FREERTOS_HZ=1000
CONFIG_FREERTOS_UNICORE=n
```
